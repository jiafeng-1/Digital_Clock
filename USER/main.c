#include "led.h"
#include "ds3231.h"
#include "delay.h"
#include "key.h"
#include "sys.h"
#include "lcd.h"
#include "usart.h"



DS3231_InitTypeDef 		DS3231_ReadDate;
DS3231_Alarm1TypeDef  DS3231_Alarm1Read ;
DS3231_InitTypeDef  	DS3231_WriteDate; 
DS3231_Alarm1TypeDef  DS3231_Alarm1Write;

const uint16_t x0Font[]={0xFF,0xFF,0xFF,0xFF,0xFF,0xFF,0xFF,0xFF,0xFF,0xFF,0xFF,0xFF,0xFF,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0xFF,
0xFF,0xFF,0xFF,0xFF,0xFF,0xFF,0xFF,0xFF,0xFF,0xFF,0xFF,0xFF,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0xFF,
0xFF,0xFF,0xFF,0xFF,0xFF,0xFF,0xFF,0xFF,0xFF,0xFF,0xFF,0xFF,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0xFF,
0xFF,0xFF,0xFF,0xF0,0x00,0x00,0x07,0xFF,0xFF,0xFF,0xFF,0xFF,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0xFF,
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0xFF,0xFF,0xFF,0xFF,0xFF,0xFF,0xFF,0xFF,0xFF,0xFF,0xFF,0xFF,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0xFF,
//number1
0xFF,0xFF,0xFF,0xFF,0xFF,0xFF,0xFF,0xFF,0xFF,0xFF,0xFF,0xFF,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0xFF,
0xFF,0xFF,0xFF,0xFF,0xFF,0xFF,0xFF,0xFF,0xFF,0xFF,0xFF,0xFF,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0xFF,
0xFF,0xFF,0xFF,0xFF,0xFF,0xFF,0xFF,0xFF,0xFF,0xFF,0xFF,0xFF,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0xFF,
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0xFF,0xFF,0xFF,0xFF,0xFF,0xFF,0xFF,0xFF,0xFF,0xFF,0xFF,0xFF,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0xFF,
//number2
0xFF,0xFF,0xFF,0xFF,0xFF,0xFF,0xFF,0xFF,0xFF,0xFF,0xFF,0xFF,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0xFF,
0xFF,0xFF,0xFF,0xFF,0xFF,0xFF,0xFF,0xFF,0xFF,0xFF,0xFF,0xFF,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0xFF,
0xFF,0xFF,0xFF,0xFF,0xFF,0xFF,0xFF,0xFF,0xFF,0xFF,0xFF,0xFF,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0xFF,
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0xFF,0xFF,0xFF,0xFF,0xFF,0xFF,0xFF,0xFF,0xFF,0xFF,0xFF,0xFF,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0xFF,

//number3
0xFF,0xFF,0xFF,0xFF,0xFF,0xFF,0xFF,0xFF,0xFF,0xFF,0xFF,0xFF,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0xFF,
0xFF,0xFF,0xFF,0xFF,0xFF,0xFF,0xFF,0xFF,0xFF,0xFF,0xFF,0xFF,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0xFF,
0xFF,0xFF,0xFF,0xFF,0xFF,0xFF,0xFF,0xFF,0xFF,0xFF,0xFF,0xFF,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0xFF,
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0xFF,0xFF,0xFF,0xFF,0xFF,0xFF,0xFF,0xFF,0xFF,0xFF,0xFF,0xFF,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0xFF,
//number4
0xFF,0xFF,0xFF,0xFF,0xFF,0xFF,0xFF,0xFF,0xFF,0xFF,0xFF,0xFF,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0xFF,
0xFF,0xFF,0xFF,0xFF,0xFF,0xFF,0xFF,0xFF,0xFF,0xFF,0xFF,0xFF,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0xFF,
0xFF,0xFF,0xFF,0xFF,0xFF,0xFF,0xFF,0xFF,0xFF,0xFF,0xFF,0xFF,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0xFF,
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0xFF,0xFF,0xFF,0xFF,0xFF,0xFF,0xFF,0xFF,0xFF,0xFF,0xFF,0xFF,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0xFF,
//number5
0xFF,0xFF,0xFF,0xFF,0xFF,0xFF,0xFF,0xFF,0xFF,0xFF,0xFF,0xFF,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0xFF,
0xFF,0xFF,0xFF,0xFF,0xFF,0xFF,0xFF,0xFF,0xFF,0xFF,0xFF,0xFF,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0xFF,
0xFF,0xFF,0xFF,0xFF,0xFF,0xFF,0xFF,0xFF,0xFF,0xFF,0xFF,0xFF,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0xFF,
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0xFF,0xFF,0xFF,0xFF,0xFF,0xFF,0xFF,0xFF,0xFF,0xFF,0xFF,0xFF,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0xFF,

//number6
0xFF,0xFF,0xFF,0xFF,0xFF,0xFF,0xFF,0xFF,0xFF,0xFF,0xFF,0xFF,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0xFF,
0xFF,0xFF,0xFF,0xFF,0xFF,0xFF,0xFF,0xFF,0xFF,0xFF,0xFF,0xFF,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0xFF,
0xFF,0xFF,0xFF,0xFF,0xFF,0xFF,0xFF,0xFF,0xFF,0xFF,0xFF,0xFF,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0xFF,
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0xFF,0xFF,0xFF,0xFF,0xFF,0xFF,0xFF,0xFF,0xFF,0xFF,0xFF,0xFF,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0xFF
,//number7
0xFF,0xFF,0xFF,0xFF,0xFF,0xFF,0xFF,0xFF,0xFF,0xFF,0xFF,0xFF,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0xFF,
0xFF,0xFF,0xFF,0xFF,0xFF,0xFF,0xFF,0xFF,0xFF,0xFF,0xFF,0xFF,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0xFF,
0xFF,0xFF,0xFF,0xFF,0xFF,0xFF,0xFF,0xFF,0xFF,0xFF,0xFF,0xFF,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0xFF,
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0xFF,0xFF,0xFF,0xFF,0xFF,0xFF,0xFF,0xFF,0xFF,0xFF,0xFF,0xFF,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0xFF,
//number8
0xFF,0xFF,0xFF,0xFF,0xFF,0xFF,0xFF,0xFF,0xFF,0xFF,0xFF,0xFF,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0xFF,
0xFF,0xFF,0xFF,0xFF,0xFF,0xFF,0xFF,0xFF,0xFF,0xFF,0xFF,0xFF,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0xFF,
0xFF,0xFF,0xFF,0xFF,0xFF,0xFF,0xFF,0xFF,0xFF,0xFF,0xFF,0xFF,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0xFF,
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0xFF,0xFF,0xFF,0xFF,0xFF,0xFF,0xFF,0xFF,0xFF,0xFF,0xFF,0xFF,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0xFF
,//number9
0xFF,0xFF,0xFF,0xFF,0xFF,0xFF,0xFF,0xFF,0xFF,0xFF,0xFF,0xFF,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0xFF,
0xFF,0xFF,0xFF,0xFF,0xFF,0xFF,0xFF,0xFF,0xFF,0xFF,0xFF,0xFF,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0xFF,
0xFF,0xFF,0xFF,0xFF,0xFF,0xFF,0xFF,0xFF,0xFF,0xFF,0xFF,0xFF,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0xFF,
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0xFF,0xFF,0xFF,0xFF,0xFF,0xFF,0xFF,0xFF,0xFF,0xFF,0xFF,0xFF,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0xFF

};






void Display_numb0(u16 x,u16 y,const uint16_t * font)
{
  uint8_t row_count,byte_count,bit_count;
  //160行,一行10字节,一字节八位
  for(row_count = 0;row_count < 160;row_count++)
  {
    printf("\r\n");
    for(byte_count = 0;byte_count < 10;byte_count++)
    {
      for(bit_count=0;bit_count <8;bit_count++)
      {
        
        if((*(font+row_count*10+byte_count)) & (0x80>>bit_count))
       {
         LCD_Fast_DrawPoint(x+byte_count*8+bit_count,y+row_count,BLACK);  //background  黑色
       }
       else
         LCD_Fast_DrawPoint(x+byte_count*8+bit_count,y+row_count,WHITE); //字体为白色
      }
    }
    
  }
  
};


void Draw_FullCircle1(uint16_t Xpos,uint16_t Ypos,uint16_t Radius,u16 color)
{
  uint16_t x,y,r=Radius;
  for(y=Ypos-r;y<=Ypos+r+1;y++)
  {
    for(x=Xpos-r;x<=Xpos+r+1;x++)
    {
      if((((x-Xpos)*(x-Xpos)+(y-Ypos)*(y-Ypos))<=r*r))
      {
        LCD_SetCursor(x,y);      			      	//设置光标位置 
        LCD_WriteRAM_Prepare();     		      	//开始写入GRAM	 
        LCD->LCD_RAM=color;//显示颜色
       }
     }
    }
}

 
/************************************************
 
************************************************/

 int main(void)
 {	

  uint16_t Hour,Min,Sec,temp1,temp2 ;
  const uint16_t * Font = x0Font;   
  uint8_t flag;   //声明状态寄存器，flag == 1为闹钟事件触发
  
	u8 lcd_id[12];			                              //存放LCD ID字符串
	delay_init();	    	                              //延时函数初始化	  
	NVIC_PriorityGroupConfig(NVIC_PriorityGroup_2);	  //设置NVIC中断分组2:2位抢占优先级，2位响应优先级
	uart_init(115200);	 	                            //串口初始化为115200
 	LED_Init();			                                  //LED端口初始化
	
  I2C_ENABLE_Init();                                //I2C初始化
   
  	/*设置时钟*/
	DS3231_WriteDate.Sec = 0;
	DS3231_WriteDate.Min = 50;
  DS3231_WriteDate.Hour = 23;
	DS3231_WriteDate.Date = 28;
	DS3231_WriteDate.Day = 1;
	DS3231_WriteDate.Month = 9;
	DS3231_WriteDate.Year = 20;
//  printf("\r\nstructure ok\r\n");//调试语句，（可执行）。
  
 DS3231_SetDataTime(I2C1,& DS3231_WriteDate);
  //调试语句，（未执行）
  printf("\r\n%d/%d/:%d/%d--%d\r\n",DS3231_WriteDate.Year,DS3231_WriteDate.Month,DS3231_WriteDate.Hour,DS3231_WriteDate.Day,DS3231_WriteDate.Day);	 
/*------------------------------------------------------------------------------------------------*/
  /*设置闹钟，并开启控制寄存器*/
  SetCtrlRegister(I2C1);
 	
  I2C_ENABLE_Init();
	DS3231_Alarm1Write.Seconds = 1;
	DS3231_Alarm1Write.Minutes = 35 ;
	DS3231_Alarm1Write.Hour = 22;
	DS3231_Alarm1Write.Day = 0;
	printf("\r\n%d/%d/:%d\r\n",DS3231_Alarm1Write.Seconds,DS3231_Alarm1Write.Minutes,DS3231_Alarm1Write.Hour);
	SetAlarmOne ( I2C1,&DS3231_Alarm1Write); 
	printf("初始化完成\t\n");
  
  
  

   LCD_Init();                                  //LCD初始化（背光亮，清屏）
  
  /*-----------------------------------------------------------------------------------------------*/
  
	POINT_COLOR = RED;
  
	sprintf((char*)lcd_id,"LCD ID:%d",lcddev.id);//将LCD ID打印到lcd_id数组。 
  LCD_Display_Dir(1);
   
  
  	while(1) 
	{
      
    
    RCC_AHBPeriphClockCmd(RCC_AHBPeriph_FSMC,DISABLE);	
 
//		printf("\r\n gettime ok\r\n");               //调试语句，
//		//--------------------------获取时间函数，并实时刷新打印时间--------------------
//		DS3231_GetDateTime(I2C1,&DS3231_ReadDate);
//        
//		//sprintf((char*)alarm,"data:%d:%d:%d",DS3231_ReadDate.Hour,DS3231_ReadDate.Min,DS3231_ReadDate.Sec);
//    
//    
//	  printf("\r\n %d: %d : %d--%d\r\n",DS3231_ReadDate.Hour,DS3231_ReadDate.Min,DS3231_ReadDate.Sec,DS3231_ReadDate.Day );
//	  I2C_ENABLE_Init();                             //I2C初始化
//    printf("\r\n打印完成\r\n");
//		
//	  printf("\r\n %d \r\n",GetCotrolRegister(I2C1));//打印控制寄存器的值
//    printf("\r\n闹钟设定时间%d：%d/：%d\r\n",DS3231_Alarm1Write.Hour,DS3231_Alarm1Write.Minutes,DS3231_Alarm1Write.Seconds);
//	  
//    flag = DS3231_GetFlag(I2C1);                   //获取寄存器状态
//    if(flag == 1)
//		{
//			printf("\r\n闹钟触发");
//			printf("\r\n闹钟触发");
//			printf("\r\n闹钟触发");
//			printf("\r\n闹钟触发");
//			DS3231_ClearFlag(I2C1);                       //清除寄存器状态
//		}
//	  else
    DS3231_GetDateTime(I2C1,&DS3231_ReadDate);
	 
    printf("\r\n %d: %d : %d--%d\r\n",DS3231_ReadDate.Hour,DS3231_ReadDate.Min,DS3231_ReadDate.Sec,DS3231_ReadDate.Day);
    Hour = DS3231_ReadDate.Hour;
    Min  = DS3231_ReadDate.Min;
    Sec = DS3231_ReadDate.Sec;
 
    RCC_AHBPeriphClockCmd(RCC_AHBPeriph_FSMC,ENABLE);	
	  
    
    
    if(Hour != (DS3231_ReadDate.Hour))
    LCD_Clear(BLACK);                 /*****局部清理屏幕******/
    if(Hour<10)
    { 
      Display_numb0(0,40,Font);
      Display_numb0(70,40,(Font+Hour*1600));
      delay_ms(100);
    }
    else
    { 
      temp1 = Hour/10;
      temp2 = Hour%10;
      
      
      //偏移量为1600字节，在首地址的基础上乘以1600*temp1|1600*temp2
      //temp = temp1*8byte*160ray(1600byte)
     
      Display_numb0(0,40, Font+temp1*1600);
      Display_numb0(70,40,Font+temp2*1600);
      
      delay_ms(100);
    }
    if(Sec & 0x01)
      {
        Draw_FullCircle1(160,70,10,BLACK);
        Draw_FullCircle1(160,170,10,BLACK);
        Draw_FullCircle1(160,90 ,10,YELLOW );
        Draw_FullCircle1(160,150,10,YELLOW );
        
      }
      else
      {
        Draw_FullCircle1(160,90 ,10,BLACK  );
        Draw_FullCircle1(160,150,10,BLACK );
        
        Draw_FullCircle1(160,70,10,BLUE);
        Draw_FullCircle1(160,170,10,BLUE );
        
      }
    
//    if(Min != (DS3231_ReadDate.Min))
//    LCD_Clear(BLACK);                 /*****局部清理屏幕******/
        
    if(Min<10)
    { 
      Display_numb0(170,40,Font);
      
      Display_numb0(250,40,(Font+Min*1600));
      delay_ms(100);
    }
    else
    { 
      temp1 = Min / 10;
      temp2 = Min % 10;
      
      
      //偏移量为1600字节，在首地址的基础上乘以1600*temp1|1600*temp2
      //temp = temp1*8byte*160ray(1600byte)
     
      Display_numb0(170,40, Font+temp1*1600);
      Display_numb0(250,40, Font+temp2*1600);
      
      delay_ms(100);
    }
    
    
  }
    
    
    
  }
  
 
    
//    Display_numb0(0,40,x9Font);
//    delay_ms(1000);
//    Display_numb0(70,40,x9Font);
//    delay_ms(1000);
//    Draw_FullCircle1(160,80 ,10,BLACK );
//    Draw_FullCircle1(160,160,10,BLACK );
//    Display_numb0(170,40,x9Font);
//    delay_ms(1000);
//    Display_numb0(241,40,x9Font);
  
  
  
  
  
		
	
	 

 